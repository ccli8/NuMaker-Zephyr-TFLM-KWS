## CMakeLists.txt
```
# Copyright (c) 2025 Nuvoton Technology Corporation
# SPDX-License-Identifier: Apache-2.0

cmake_minimum_required(VERSION 3.20.0)

find_package(Zephyr REQUIRED HINTS $ENV{ZEPHYR_BASE})

project(NuMaker-Zephyr-TFLM-KWS)

target_compile_definitions(app
  PRIVATE
    # Required by app for dcache conditional code
    $<$<BOOL:${CONFIG_CACHE_MANAGEMENT}>:NVT_DCACHE_ON>
    # Required by app to enable DMIC
    $<$<BOOL:${CONFIG_NVT_ML_KWS_INPUT_DMIC}>:USE_DMIC>
    # Required by app to enable Ethos-U profiling
    $<$<BOOL:${CONFIG_NVT_ML_ETHOS_U_PROFILE}>:__PROFILE__>
    # Required by ml-embedded-evaluation-kit to go Ethos-U way
    $<$<BOOL:${CONFIG_NVT_ML_REQUIRES_ETHOS_U}>:ARM_NPU>
    # Required by TFLM to define tensor arena size
    ACTIVATION_BUF_SZ=${CONFIG_NVT_ML_TFLM_TENSOR_ARENA_SIZE}
    # Required by app to tell which model
    $<$<BOOL:${CONFIG_NVT_ML_KWS_MODEL_DS_CNN}>:MODEL_DS_CNN>
)

set(APP_SOURCE_DIR ${CMAKE_CURRENT_SOURCE_DIR}/src)

target_include_directories(app
  PRIVATE
    ${APP_SOURCE_DIR}/Device/include
    ${APP_SOURCE_DIR}/ml-embedded-evaluation-kit_clone/application_api_common/include
    ${APP_SOURCE_DIR}/ml-embedded-evaluation-kit_clone/application_api_use_case_kws/include
    ${APP_SOURCE_DIR}/ml-embedded-evaluation-kit_clone/application_main/include
    ${APP_SOURCE_DIR}/ml-embedded-evaluation-kit_clone/log/include
    ${APP_SOURCE_DIR}/ml-embedded-evaluation-kit_clone/math/include
    ${APP_SOURCE_DIR}/ml-embedded-evaluation-kit_clone/profiler/include
    ${APP_SOURCE_DIR}/Model/include
    ${APP_SOURCE_DIR}/MQTT/include
    ${APP_SOURCE_DIR}/NPU/include
    ${APP_SOURCE_DIR}/Pattern/include
    ${APP_SOURCE_DIR}/ProfilerCounter/include
    ${APP_SOURCE_DIR}
)

# Add all BSP_Clone *.cc/*.cpp/*.c files
if(CONFIG_SOC_SERIES_M55M1X)
  file(GLOB_RECURSE SOURCE_BSP_CLONE
    "${APP_SOURCE_DIR}/BSP_Clone/M55M1_StdDriver/*.cc"
    "${APP_SOURCE_DIR}/BSP_Clone/M55M1_StdDriver/*.cpp"
    "${APP_SOURCE_DIR}/BSP_Clone/M55M1_StdDriver/*.c"
  )
endif()

# Add all Device *.cc/*.cpp/*.c files
file(GLOB_RECURSE SOURCE_DEVICE
    "${APP_SOURCE_DIR}/Device/*.cc"
    "${APP_SOURCE_DIR}/Device/*.cpp"
    "${APP_SOURCE_DIR}/Device/*.c"
)
# Exclude DMIC*.c* or dmic*.c* files if not enabled
if(NOT CONFIG_NVT_ML_KWS_INPUT_DMIC)
    list(FILTER SOURCE_DEVICE EXCLUDE REGEX ".*(DMIC)|(dmic).*\\.c.*$")
endif()
# Exclude HyperRAM*.c* or hyperram*.c* files if not enabled
if(NOT CONFIG_NVT_ML_HYPERRAM)
    list(FILTER SOURCE_DEVICE EXCLUDE REGEX ".*(HyperRAM)|(hyperram).*\\.c.*$")
endif()

# Add all ml-embedded-evaluation-kit_clone *.cc/*.cpp/*.c files
file(GLOB_RECURSE SOURCE_ML_EMBEDDED_EVALUATION_KIT_CLONE
    "${APP_SOURCE_DIR}/ml-embedded-evaluation-kit_clone/*.cc"
    "${APP_SOURCE_DIR}/ml-embedded-evaluation-kit_clone/*.cpp"
    "${APP_SOURCE_DIR}/ml-embedded-evaluation-kit_clone/*.c"
)

# Add all Model *.cc/*.cpp/*.c files
file(GLOB_RECURSE SOURCE_MODEL
    "${APP_SOURCE_DIR}/Model/*.cc"
    "${APP_SOURCE_DIR}/Model/*.cpp"
    "${APP_SOURCE_DIR}/Model/*.c"
)

if(CONFIG_NVT_ML_KWS_OUTPUT_MQTT)
    # Add all MQTT *.cc/*.cpp/*.c files
    file(GLOB_RECURSE SOURCE_MQTT
        "${APP_SOURCE_DIR}/MQTT/*.cc"
        "${APP_SOURCE_DIR}/MQTT/*.cpp"
        "${APP_SOURCE_DIR}/MQTT/*.c"
    )
endif()

# Add all NPU *.cc/*.cpp/*.c files
file(GLOB_RECURSE SOURCE_NPU
    "${APP_SOURCE_DIR}/NPU/*.cc"
    "${APP_SOURCE_DIR}/NPU/*.cpp"
    "${APP_SOURCE_DIR}/NPU/*.c"
)
# Exclude ethosu*.c* or ethos_u*.c* files if not enabled
if(NOT CONFIG_NVT_ML_REQUIRES_ETHOS_U)
    list(FILTER SOURCE_NPU EXCLUDE REGEX ".*ethos_?u.*\\.c.*$")
endif()

# Add all Pattern *.cc/*.cpp/*.c files
file(GLOB_RECURSE SOURCE_PATTERN
    "${APP_SOURCE_DIR}/Pattern/*.cc"
    "${APP_SOURCE_DIR}/Pattern/*.cpp"
    "${APP_SOURCE_DIR}/Pattern/*.c"
)

if(CONFIG_NVT_ML_ETHOS_U_PROFILE)
    # Add all ProfilerCounter *.cc/*.cpp/*.c files
    file(GLOB_RECURSE SOURCE_PROFILER_COUNTER
        "${APP_SOURCE_DIR}/ProfilerCounter/*.cc"
        "${APP_SOURCE_DIR}/ProfilerCounter/*.cpp"
        "${APP_SOURCE_DIR}/ProfilerCounter/*.c"
    )
endif()

# Add root *.cc/*.cpp/*.c files
file(GLOB SOURCE_ROOT
    "${APP_SOURCE_DIR}/*.cc"
    "${APP_SOURCE_DIR}/*.cpp"
    "${APP_SOURCE_DIR}/*.c"
)

target_sources(app
  PRIVATE
    ${SOURCE_BSP_CLONE}
    ${SOURCE_DEVICE}
    ${SOURCE_ML_EMBEDDED_EVALUATION_KIT_CLONE}
    ${SOURCE_MODEL}
    ${SOURCE_MQTT}
    ${SOURCE_NPU}
    ${SOURCE_PATTERN}
    ${SOURCE_PROFILER_COUNTER}
    ${SOURCE_ROOT}
)

# Add networking common code
include(${ZEPHYR_BASE}/samples/net/common/common.cmake)

# Add HyperRAM sections
zephyr_linker_sources(SECTIONS hyperram.ld)
```

## Kconfig
```
# Copyright (c) 2025 Nuvoton Technology Corporation
# SPDX-License-Identifier: Apache-2.0

config NVT_ML_HYPERRAM
	bool

config NVT_ML_REQUIRES_HYPERRAM
	bool
	select NVT_ML_HYPERRAM

config NVT_ML_HYPERRAM_TENSOR_ARENA
	bool "Allocate TFLM tensor arena in HyperRAM"
	select NVT_ML_REQUIRES_HYPERRAM

config NVT_ML_REQUIRES_ETHOS_U
	bool
	select ETHOS_U

config NVT_ML_ETHOS_U_PROFILE
	bool "Enable Ethos-U profiling"
	depends on NVT_ML_REQUIRES_ETHOS_U
	help
	  Enable Ethos-U profiling

config NVT_ML_TFLM_TENSOR_ARENA_SIZE
	int "TFLM tensor arena size"
	default 280000
	help
	  Define TFLM tensor arena size

choice NVT_ML_KWS_INPUT_CHOICE
	prompt "Choose ML keyword spotting input source"
	default NVT_ML_KWS_INPUT_DMIC if BOARD_NUMAKER_M55M1

config NVT_ML_KWS_INPUT_DMIC
	bool "DMIC as KWS input"
	help
	  Use digital microphone as keyword spotting input

config NVT_ML_KWS_INPUT_WAVE_BLOB
	bool "Wave blob as KWS input"
	help
	  Use embedded wave blob as keyword spotting input

endchoice

choice NVT_ML_KWS_MODEL_CHOICE
	prompt "Choose ML keyword spotting model"
	default NVT_ML_KWS_MODEL_DS_CNN

config NVT_ML_KWS_MODEL_DS_CNN
	bool "ML DS CNN keyword spotting model"
	select NVT_ML_REQUIRES_ETHOS_U

config NVT_ML_KWS_MODEL_MICRONET
	bool "ML MicroNet keyword spotting model"
	select NVT_ML_REQUIRES_ETHOS_U

endchoice

config NVT_ML_KWS_OUTPUT_MQTT
	bool "MQTT as KWS output"
	default y if DNS_RESOLVER
	depends on ETH_NUMAKER || WIFI_ESP_AT
	select MQTT_LIB
	help
	  Use mqtt as keyword spotting output

config NVT_ML_KWS_MQTT_TOPIC
	string "Un-namespaced name of MQTT topic"
	default "kws"
	depends on NVT_ML_KWS_OUTPUT_MQTT
	help
	  Un-namespaced name of mqtt topic. The full topic name will
	  namespace as <CLIENT_ID>/<NVT_ML_KWS_MQTT_TOPIC> where to
	  publish keyword spotting output.

source "Kconfig.zephyr"
```

## prj.conf
```kconfig
CONFIG_CPP=y
CONFIG_STD_CPP17=y

CONFIG_TENSORFLOW_LITE_MICRO=y
# Enable if model is vela-compiled
#CONFIG_ETHOS_U=y

CONFIG_CMSIS_DSP=y
CONFIG_CMSIS_DSP_COMPLEXMATH=y
CONFIG_CMSIS_DSP_FASTMATH=y
CONFIG_CMSIS_DSP_TRANSFORM=y

# MPU fault may imply stack overflow
CONFIG_MAIN_STACK_SIZE=4096
# Used for k_malloc in ethos-u driver overrides ethosu_mutex_create
# and ethosu_semaphore_create
CONFIG_HEAP_MEM_POOL_SIZE=16384

# Use shell instead of unsupported getchar
CONFIG_SHELL=y

# Enable FPU
CONFIG_FPU=y
CONFIG_FPU_SHARING=y
CONFIG_FP_HARDABI=y

# Networking
CONFIG_NETWORKING=y
CONFIG_NET_IPV4=y
CONFIG_NET_IPV6=n
CONFIG_NET_TCP=y
CONFIG_NET_SOCKETS=y
CONFIG_POSIX_API=y
CONFIG_TEST_RANDOM_GENERATOR=y
CONFIG_NET_LOG=y

# Adjust network buffers/packets
CONFIG_NET_BUF_RX_COUNT=30
CONFIG_NET_BUF_TX_COUNT=40
CONFIG_NET_PKT_RX_COUNT=15
CONFIG_NET_PKT_TX_COUNT=20

# Logging
CONFIG_LOG=y
CONFIG_REQUIRES_FLOAT_PRINTF=y
# Reduce log messages dropped
CONFIG_LOG_BLOCK_IN_THREAD=y

# Performance
# Enable cache
CONFIG_CACHE_MANAGEMENT=y
# Match BSP optimization level
CONFIG_SPEED_OPTIMIZATIONS=y
```

## overlay-eth.conf
```kconfig
# Disable default configurations
CONFIG_NET_CONFIG_SETTINGS=n
CONFIG_NET_CONFIG_MY_IPV4_ADDR=""
CONFIG_NET_CONFIG_PEER_IPV4_ADDR=""
CONFIG_NET_CONFIG_MY_IPV4_GW=""

# Add DNS server e.g. Google Public DNS
CONFIG_DNS_RESOLVER=y
CONFIG_DNS_SERVER_IP_ADDRESSES=y
CONFIG_DNS_SERVER1="8.8.8.8"

# Enable DHCP
CONFIG_NET_DHCPV4=y

# Enable connection manager for net_if up 
CONFIG_NET_CONNECTION_MANAGER=y

# Etherent log level
CONFIG_ETHERNET_LOG_LEVEL_INF=y
```

## overlay-tls.conf
```kconfig
# Overall
#CONFIG_MAIN_STACK_SIZE=4096
CONFIG_MQTT_LIB_TLS=y
CONFIG_NET_SOCKETS_SOCKOPT_TLS=y

# Mbed TLS
CONFIG_MBEDTLS=y
CONFIG_MBEDTLS_BUILTIN=y
CONFIG_MBEDTLS_ENABLE_HEAP=y
CONFIG_MBEDTLS_HEAP_SIZE=30000
CONFIG_MBEDTLS_SSL_MAX_CONTENT_LEN=4096

# Mbed TLS debugging
#CONFIG_MBEDTLS_DEBUG=y
#CONFIG_MBEDTLS_LOG_LEVEL_ERR=y
```

## overlay-wifi.conf
```kconfig
# Disable default configurations
CONFIG_NET_CONFIG_SETTINGS=n
CONFIG_NET_CONFIG_MY_IPV4_ADDR=""
CONFIG_NET_CONFIG_PEER_IPV4_ADDR=""
CONFIG_NET_CONFIG_MY_IPV4_GW=""

# Enable WiFi
CONFIG_WIFI=y

# Enable WiFi shell
# Issue shell command "wifi connect" for WiFi connection
CONFIG_NET_SHELL=y
CONFIG_NET_L2_WIFI_SHELL=y

# Add DNS server e.g. Google Public DNS
CONFIG_DNS_RESOLVER=y
CONFIG_DNS_SERVER_IP_ADDRESSES=y
CONFIG_DNS_SERVER1="8.8.8.8"

# Enlarge DNS query timeout to 20s (see CONFIG_NET_SOCKETS_DNS_TIMEOUT
# and CONFIG_NET_SOCKETS_DNS_BACKOFF_INTERVAL for details)
CONFIG_NET_SOCKETS_DNS_TIMEOUT=20000

# Enable connection manager for net_if up
CONFIG_NET_CONNECTION_MANAGER=y

# Longer connection time for TLS handshake
CONFIG_NET_SOCKETS_CONNECT_TIMEOUT=10000

# Fix OOM error in TLS handshake
# esp_socket.c > esp_socket_prepare_pkt > net_pkt_rx_alloc_with_buffer
CONFIG_NET_BUF_RX_COUNT=32

# WiFi log level
CONFIG_WIFI_LOG_LEVEL_INF=y
# Suppress annoying message below for offload l2 send unsupported:
# "<wrn> net_if: l2 for iface 1 cannot send, discard pkt"
CONFIG_NET_IF_LOG_LEVEL_ERR=y
```

## boards/numaker_m55m1.overlay
```dts
/* SPDX-License-Identifier: Apache-2.0 */

&npu0 {
	status = "okay";
};

/* DMIC */
&gpiob {
	status = "okay";
};

/* Some EMAC pins need to adjust skew and so GPIOE port needs to be
 * enabled. This will become duplicate and can be removed when upstream.
 */
&gpioe {
	status = "okay";
};
```

## src/main.cpp
```c
/**************************************************************************//**
 * @file     main.cpp
 * @version  V1.00
 * @brief    DS-CNN network sample. Demonstrate keyword spotting
 *
 * @copyright SPDX-License-Identifier: Apache-2.0
 * @copyright Copyright (C) 2023 Nuvoton Technology Corp. All rights reserved.
 ******************************************************************************/

#include "BoardInit.hpp"      /* Board initialisation */
/* On zephyr, redirect ml-embedded-evaluation-kit logging to zephyr way */
#if defined(__ZEPHYR__)
#define REGISTER_LOG_MODULE_APP 1
#endif
#include "log_macros.h"      /* Logging macros (optional) */

#include "AudioUtils.hpp"
#include "BufAttributes.hpp" /* Buffer attributes to be applied */
#include "Classifier.hpp"    /* Classifier for the result */
#include "ClassificationResult.hpp"
#include "InputFiles.hpp"             /* Baked-in input (not needed for live data) */
#include "KwsModel.hpp"       /* Model API */
#include "Labels.hpp"
#include "MicroNetKwsMfcc.hpp"
#include "KwsProcessing.hpp" /* Pre and Post Process */
#include "KwsResult.hpp"

#undef PI /* PI macro conflict with CMSIS/DSP */
#include "NuMicro.h"

/* On zephyr, configure via Kconfig */
#if defined(__ZEPHYR__)
#include "DMICRecord.h"
#include "Profiler.hpp"
#else
//#define __PROFILE__
#define USE_DMIC
#include "DMICRecord.h"

#if defined(__PROFILE__)
    #include "Profiler.hpp"
#endif
#endif

#if defined(__ZEPHYR__)
#include <zephyr/shell/shell.h>
#if defined(CONFIG_NVT_ML_KWS_OUTPUT_MQTT)
#include "ezmqtt/config.h"
#include "ezmqtt/ezmqtt.h"
#endif
#endif

namespace arm
{
namespace app
{
/* Tensor arena buffer */
static uint8_t tensorArena[ACTIVATION_BUF_SZ] ACTIVATION_BUF_ATTRIBUTE;

/* Optional getter function for the model pointer and its size. */
namespace kws
{
/* On zephyr, use shell instead of unsupported getchar */
#if defined(__ZEPHYR__)

K_MUTEX_DEFINE(mutex_record_ctrl);
K_CONDVAR_DEFINE(condvar_record_ctrl);

static bool record_ctrl_cont;
static bool record_ctrl_oneshot;
static bool record_ctrl_end;

static int kws_next_cmd_handler(const struct shell *sh, size_t argc, char **argv)
{
    ARG_UNUSED(sh);
    ARG_UNUSED(argc);
    ARG_UNUSED(argv);

    k_mutex_lock(&mutex_record_ctrl, K_FOREVER);
#if !defined(USE_DMIC)
    record_ctrl_cont = false;
    record_ctrl_oneshot = true;
#else
    record_ctrl_cont = true;
    record_ctrl_oneshot = false;
    shell_print(sh, "Not support one-shot for DMIC\n");
#endif
    k_condvar_signal(&condvar_record_ctrl);
    k_mutex_unlock(&mutex_record_ctrl);

    return 0;
}

static int kws_exit_cmd_handler(const struct shell *sh, size_t argc,
			        char **argv)
{
    ARG_UNUSED(sh);
    ARG_UNUSED(argc);
    ARG_UNUSED(argv);

    k_mutex_lock(&mutex_record_ctrl, K_FOREVER);
    record_ctrl_cont = false;
    record_ctrl_oneshot = false;
    record_ctrl_end = true;
    k_condvar_signal(&condvar_record_ctrl);
    k_mutex_unlock(&mutex_record_ctrl);

    return 0;
}

static int kws_resume_cmd_handler(const struct shell *sh, size_t argc, char **argv)
{
    ARG_UNUSED(sh);
    ARG_UNUSED(argc);
    ARG_UNUSED(argv);

    k_mutex_lock(&mutex_record_ctrl, K_FOREVER);
    record_ctrl_cont = true;
    record_ctrl_oneshot = false;
    k_condvar_signal(&condvar_record_ctrl);
    k_mutex_unlock(&mutex_record_ctrl);

    return 0;
}

static int kws_suspend_cmd_handler(const struct shell *sh, size_t argc, char **argv)
{
    ARG_UNUSED(sh);
    ARG_UNUSED(argc);
    ARG_UNUSED(argv);

    k_mutex_lock(&mutex_record_ctrl, K_FOREVER);
    record_ctrl_cont = false;
    record_ctrl_oneshot = false;
    k_condvar_signal(&condvar_record_ctrl);
    k_mutex_unlock(&mutex_record_ctrl);

    return 0;
}

SHELL_STATIC_SUBCMD_SET_CREATE(kws_subcmd_set,
	SHELL_CMD_ARG(exit, NULL, "Exit kws app", kws_exit_cmd_handler, 1, 0),
	SHELL_CMD_ARG(next, NULL, "Resume kws recording one-shot", kws_next_cmd_handler, 1, 0),
	SHELL_CMD_ARG(resume, NULL, "Resume kws recording continuously", kws_resume_cmd_handler, 1, 0),
	SHELL_CMD_ARG(suspend, NULL, "Suspend kws recording", kws_suspend_cmd_handler, 1, 0),
	SHELL_SUBCMD_SET_END
);

SHELL_CMD_REGISTER(kws, &kws_subcmd_set, "kws", NULL);

#endif

extern uint8_t *GetModelPointer();
extern size_t GetModelLen();
} /* namespace kws */
} /* namespace app */
} /* namespace arm */

int main()
{
    /* Initialise the UART module to allow printf related functions (if using retarget) */
    BoardInit();

#if defined(__ZEPHYR__)
    int rc = 0;

#if defined(CONFIG_NVT_ML_KWS_OUTPUT_MQTT)
    static char mqtt_client_id[30];
    static char mqtt_payload[128];
    static char mqtt_topic[60];

    rc = ezmqtt_setup();
    if (rc < 0) {
        printf_err("Failed to initialise mqtt: %d\n", rc);
        return 1;
    }

    rc = ezmqtt_get_client_id(mqtt_client_id, sizeof(mqtt_client_id));
    if (rc < 0) {
        printf_err("Failed to get mqtt client id: %d\n", rc);
        return 1;
    }

    rc = snprintf(mqtt_topic, sizeof(mqtt_topic), "%s/%s", mqtt_client_id, CONFIG_NVT_ML_KWS_MQTT_TOPIC);
    if (rc < 0 || rc >= sizeof(mqtt_topic)) {
        printf_err("Failed to form mqtt topic name\n");
        return 1;
    }
#endif
#endif

    /* Model object creation and initialisation. */
    arm::app::KwsModel model;

    if (!model.Init(arm::app::tensorArena,
                    sizeof(arm::app::tensorArena),
                    arm::app::kws::GetModelPointer(),
                    arm::app::kws::GetModelLen()))
    {
        printf_err("Failed to initialise model\n");
        return 1;
    }

    /*
     * On zephyr, configure mpu region for tensor arena in zephyr way
     * rather than direct control
     */
#if !defined(__ZEPHYR__)
    /* Setup cache poicy of tensor arean buffer */
    info("Set tesnor arena cache policy to WTRA \n");
    const std::vector<ARM_MPU_Region_t> mpuConfig =
    {
        {
            // SRAM for tensor arena
            ARM_MPU_RBAR(((unsigned int)arm::app::tensorArena),        // Base
                         ARM_MPU_SH_NON,    // Non-shareable
                         0,                 // Read-only
                         1,                 // Non-Privileged
                         1),                // eXecute Never enabled
            ARM_MPU_RLAR((((unsigned int)arm::app::tensorArena) + ACTIVATION_BUF_SZ - 1),        // Limit
                         eMPU_ATTR_CACHEABLE_WTRA) // Attribute index - Write-Through, Read-allocate
        }
    };

    // Setup MPU configuration
    InitPreDefMPURegion(&mpuConfig[0], mpuConfig.size());
#endif

    constexpr int minTensorDims = static_cast<int>(
                                      (arm::app::KwsModel::ms_inputRowsIdx > arm::app::KwsModel::ms_inputColsIdx)
                                      ? arm::app::KwsModel::ms_inputRowsIdx
                                      : arm::app::KwsModel::ms_inputColsIdx);

    const auto mfccFrameLength = 640;
    const auto mfccFrameStride = 320;
    const auto scoreThreshold  = 0.75;

    /* Get Input and Output tensors for pre/post processing. */
    TfLiteTensor *inputTensor  = model.GetInputTensor(0);
    TfLiteTensor *outputTensor = model.GetOutputTensor(0);

    if (!inputTensor->dims)
    {
        printf_err("Invalid input tensor dims\n");
        return 2;
    }
    else if (inputTensor->dims->size < minTensorDims)
    {
        printf_err("Input tensor dimension should be >= %d\n", minTensorDims);
        return 3;
    }

    /* Get input shape for feature extraction. */
    TfLiteIntArray *inputShape     = model.GetInputShape(0);
#if defined (MODEL_DS_CNN)
    const uint32_t numMfccFeatures = 10;
    const uint32_t numMfccFrames = 49;
#else
    const uint32_t numMfccFeatures = inputShape->data[arm::app::KwsModel::ms_inputColsIdx];
    const uint32_t numMfccFrames = inputShape->data[arm::app::KwsModel::ms_inputRowsIdx];
#endif

    /* We expect to be sampling 1 second worth of data at a time.
     * NOTE: This is only used for time stamp calculation. */
    const float secondsPerSample = 1.0 / arm::app::audio::MicroNetKwsMFCC::ms_defaultSamplingFreq;

    /* Classifier object for results */
    arm::app::KwsClassifier classifier;

    /* Object to hold label strings. */
    std::vector<std::string> labels;

    /* Populate the labels here. */
    GetLabelsVector(labels);

    uint8_t u8ClipIdx = 0;

#if defined(USE_DMIC)
#define AUDIO_SAMPLE_BLOCK  4
#define AUDIO_SAMPLE_RATE   16000
#define AUDIO_CHANNEL       1


    const auto audioSlidingSamples = (numMfccFrames + 1) * mfccFrameStride; //(49+1)*320 = 16000 = 1 sec
    const auto audioStrideSamples = audioSlidingSamples / 2;

    int16_t *audioSlidingBuf = new int16_t[audioSlidingSamples];
    int32_t ret;

    /* On zephyr, check heap OOM error */
#if defined(__ZEPHYR__)
    if (!audioSlidingBuf)
    {
        printf_err("Allocate DMIC record sliding buffer failed\n");
        return 4;
    }
#endif

    ret = DMICRecord_Init(AUDIO_SAMPLE_RATE, AUDIO_CHANNEL, audioSlidingSamples, AUDIO_SAMPLE_BLOCK);

    if (ret)
    {
        printf_err("Unable init DMIC record error(%d)\n", ret);
        delete []audioSlidingBuf;
        return 4;
    }

#endif


#if defined(__PROFILE__)
    arm::app::Profiler profiler;
    uint64_t u64StartCycle;
    uint64_t u64EndCycle;
#endif


#if defined(__ZEPHYR__)
    warn("Press 'kws next' to resume audio clip inference one-shot\n");
    warn("Press 'kws resume' to resume audio clip inference continuously\n");
    warn("Press 'kws suspend' to suspend audio clip inference\n");
    warn("Press 'kws exit' to exit program\n");

#if defined(CONFIG_NVT_ML_KWS_OUTPUT_MQTT)
    warn("Subscribe to MQTT topic for inference result:\n");
    warn("MQTT server: %s\n", EZMQTT_SERVER_HOSTNAME);
    warn("MQTT topic: %s\n", mqtt_topic);
#endif

#if defined(USE_DMIC)
    DMICRecord_StartRec();
#endif

    while (1)
    {
        k_mutex_lock(&arm::app::kws::mutex_record_ctrl, K_FOREVER);
        if (arm::app::kws::record_ctrl_end) {
            k_mutex_unlock(&arm::app::kws::mutex_record_ctrl);
#if defined(CONFIG_NVT_ML_KWS_OUTPUT_MQTT)
            ezmqtt_teardown();
#endif
            warn("Bye!\n");
            break;
        } else if (!arm::app::kws::record_ctrl_cont && !arm::app::kws::record_ctrl_oneshot) {
            k_condvar_wait(&arm::app::kws::condvar_record_ctrl, &arm::app::kws::mutex_record_ctrl, K_FOREVER);
            k_mutex_unlock(&arm::app::kws::mutex_record_ctrl);
            continue;
        } else if (arm::app::kws::record_ctrl_cont) {
            __ASSERT_NO_MSG(!arm::app::kws::record_ctrl_oneshot);
        } else if (arm::app::kws::record_ctrl_oneshot) {
            __ASSERT_NO_MSG(!arm::app::kws::record_ctrl_cont);
            arm::app::kws::record_ctrl_oneshot = false;
        }
        k_mutex_unlock(&arm::app::kws::mutex_record_ctrl);
#else
#if !defined(USE_DMIC)
    char chStdIn;

    info("Press 'n' to run next audio clip inference \n");
    info("Press 'q' to exit program \n");

    while ((chStdIn = getchar()))
    {
        if (chStdIn == 'q')
            break;
        else if (chStdIn != 'n')
            continue;

#else
    DMICRecord_StartRec();

    while (1)
    {
#endif
#endif

        /* Declare a container to hold results from across the whole audio clip. */
        std::vector<arm::app::kws::KwsResult> finalResults;

        /* Object to hold classification results */
        std::vector<arm::app::ClassificationResult> singleInfResult;

        /* Set up pre and post-processing. */
        arm::app::KwsPreProcess preProcess = arm::app::KwsPreProcess(
                                                 inputTensor, numMfccFeatures, numMfccFrames, mfccFrameLength, mfccFrameStride);

    /* On zephyr, KwsPostProcess has change on passing 'useSoftmax' */
#if defined(__ZEPHYR__)
#if defined(MODEL_DS_CNN)
        arm::app::KwsPostProcess postProcess =
            arm::app::KwsPostProcess(outputTensor, classifier, labels, singleInfResult, 0, false);
#else
        arm::app::KwsPostProcess postProcess =
            arm::app::KwsPostProcess(outputTensor, classifier, labels, singleInfResult, 0, true);
#endif
#else
#if defined(MODEL_DS_CNN)
        arm::app::KwsPostProcess postProcess =
            arm::app::KwsPostProcess(outputTensor, classifier, labels, singleInfResult, false);
#else
        arm::app::KwsPostProcess postProcess =
            arm::app::KwsPostProcess(outputTensor, classifier, labels, singleInfResult, true);
#endif
#endif

#if defined(USE_DMIC)

        while (DMICRecord_AvailSamples() < audioSlidingSamples)
        {
            /*
             * On zephyr, other threads will starve with busy-wait here,
	     * for example, logging thread won't work with lower priority.
	     * Change to non-busy-wait.
	     */
#if defined(__ZEPHYR__)
            DMICRecord_SleepUntilUpdate(200);
#else
            __NOP();
#endif
        }

        DMICRecord_ReadSamples(audioSlidingBuf, audioSlidingSamples);

        DMICRecord_UpdateReadSampleIndex(audioStrideSamples);

        /* Creating a sliding window through the whole audio clip. */
        auto audioDataSlider = arm::app::audio::SlidingWindow<const int16_t>(
                                   audioSlidingBuf,
                                   audioSlidingSamples,
                                   preProcess.m_audioDataWindowSize, preProcess.m_audioDataStride);

#else
        /* Creating a sliding window through the whole audio clip. */
        auto audioDataSlider = arm::app::audio::SlidingWindow<const int16_t>(
                                   get_audio_array(u8ClipIdx),
                                   get_audio_array_size(u8ClipIdx),
                                   preProcess.m_audioDataWindowSize, preProcess.m_audioDataStride);

        info("Using audio data from %s\n", get_filename(u8ClipIdx));
#endif

        /* Start sliding through audio clip. */
        while (audioDataSlider.HasNext())
        {
            const int16_t *inferenceWindow = audioDataSlider.Next();

            /* KwsPreProcess has updated on passing inference index */
#if !defined(__ZEPHYR__)
            /* The first window does not have cache ready. */
            preProcess.m_audioWindowIndex = audioDataSlider.Index();
#endif

            info("Inference %zu/%zu\n", audioDataSlider.Index() + 1,
                 audioDataSlider.TotalStrides() + 1);

#if defined(__PROFILE__)
            u64StartCycle = pmu_get_systick_Count();
#endif

            /* Run the pre-processing, inference and post-processing. */
#if defined(__ZEPHYR__)
            if (!preProcess.DoPreProcess(inferenceWindow, audioDataSlider.Index()))
#else
            if (!preProcess.DoPreProcess(inferenceWindow, arm::app::audio::MicroNetKwsMFCC::ms_defaultSamplingFreq))
#endif
            {
                printf_err("Pre-processing failed.");
                break;
            }

#if defined(__PROFILE__)
            u64EndCycle = pmu_get_systick_Count();
            info("MFCC cycles %llu \n", (u64EndCycle - u64StartCycle));
#endif


#if defined(__PROFILE__)
            profiler.StartProfiling("Inference");
#endif

            if (!model.RunInference())
            {
                printf_err("Inference failed.");
                break;
            }

#if defined(__PROFILE__)
            profiler.StopProfiling();
#endif

#if defined(__PROFILE__)
            u64StartCycle = pmu_get_systick_Count();
#endif

            if (!postProcess.DoPostProcess())
            {
                printf_err("Post-processing failed.");
                break;
            }

#if defined(__PROFILE__)
            u64EndCycle = pmu_get_systick_Count();
            info("Post process cycles %llu \n", (u64EndCycle - u64StartCycle));
#endif

            /* Add results from this window to our final results vector. */
            finalResults.emplace_back(arm::app::kws::KwsResult(singleInfResult,
                                                               audioDataSlider.Index() * secondsPerSample * preProcess.m_audioDataStride,
                                                               audioDataSlider.Index(), scoreThreshold));

        } /* while (audioDataSlider.HasNext()) */

        for (const auto &result : finalResults)
        {

            std::string topKeyword{"<none>"};
            float score = 0.f;

            if (!result.m_resultVec.empty())
            {
                topKeyword = result.m_resultVec[0].m_label;
                score      = result.m_resultVec[0].m_normalisedVal;
            }

            if (result.m_resultVec.empty())
            {
#if 0
                info("For timestamp: %f (inference #: %" PRIu32 "); label: %s; threshold: %f\n",
                     result.m_timeStamp,
                     result.m_inferenceNumber,
                     topKeyword.c_str(),
                     result.m_threshold);
#endif
            }
            else
            {
                for (uint32_t j = 0; j < result.m_resultVec.size(); ++j)
                {
#if defined(__ZEPHYR__)
#if defined(CONFIG_NVT_ML_KWS_OUTPUT_MQTT)
		    snprintf(mqtt_payload, sizeof(mqtt_payload),
		             "For timestamp: %f (inference #: %" PRIu32
                             "); label: %s, score: %f; threshold: %f\n",
                             result.m_timeStamp,
                             result.m_inferenceNumber,
                             result.m_resultVec[j].m_label.c_str(),
                             result.m_resultVec[j].m_normalisedVal,
                             result.m_threshold);
                    mqtt_payload[sizeof(mqtt_payload) - 1] = '\0';
		    rc = ezmqtt_publish_str(mqtt_topic, mqtt_payload);
		    if (rc == 0) {
                        /* MQTT publish OK */
		    } else if (rc == -EAGAIN) {
                        warn("Publish mqtt timed out\n");
                    } else {
                        printf_err("Failed to publish mqtt: %d\n", rc);
                        arm::app::kws::record_ctrl_end = true;
		    }
#endif
#endif
                    info("For timestamp: %f (inference #: %" PRIu32
                         "); label: %s, score: %f; threshold: %f\n",
                         result.m_timeStamp,
                         result.m_inferenceNumber,
                         result.m_resultVec[j].m_label.c_str(),
                         result.m_resultVec[j].m_normalisedVal,
                         result.m_threshold);
                }
            }
        }

#if defined(__PROFILE__)
        profiler.PrintProfilingResult();
#endif

        u8ClipIdx ++;

        if (u8ClipIdx >= NUMBER_OF_FILES)
            u8ClipIdx = 0;

    }

#if defined(USE_DMIC)
    delete []audioSlidingBuf;
#else
    return 0;
#endif
}
```

## src/BoardInit.cpp
```c
/**************************************************************************//**
 * @file     BoardInit.cpp
 * @version  V1.00
 * @brief    Target board initiate function
 *
 * @copyright SPDX-License-Identifier: Apache-2.0
 * @copyright Copyright (C) 2023 Nuvoton Technology Corp. All rights reserved.
 ******************************************************************************/
#include <cstdio>

#include "NuMicro.h"
#include "log_macros.h"

#include "ethosu_npu_init.h"

#define DESIGN_NAME "M55M1"

static void SYS_Init(void)
{
    /*---------------------------------------------------------------------------------------------------------*/
    /* Init System Clock                                                                                       */
    /*---------------------------------------------------------------------------------------------------------*/

    /* On zephyr, go in zephyr way */
#if defined(__ZEPHYR__)
    /* Enable FMC0 module clock to keep FMC clock when CPU idle but NPU running*/
    CLK_EnableModuleClock(FMC0_MODULE);

#if defined(USE_DMIC)
    // DMIC_APLL1_FREQ_196608KHZ for DMIC 8000/16000/48000 Hz sample-rate with 64/128/256 down-sample
    CLK_EnableAPLL(CLK_APLLCTL_APLLSRC_HIRC, DMIC_APLL1_FREQ_196608KHZ, CLK_APLL1_SELECT);
    // Select DMIC CLK source from APLL1_DIV2.
    CLK_SetModuleClock(DMIC0_MODULE, CLK_DMICSEL_DMIC0SEL_APLL1_DIV2, MODULE_NoMsk);
    // Enable DMIC clock.
    CLK_EnableModuleClock(DMIC0_MODULE);
    // DPWM IPReset.
    SYS_ResetModule(SYS_DMIC0RST);

    // LPPDMA Initial.
    CLK_EnableModuleClock(LPPDMA0_MODULE);
    CLK_EnableModuleClock(LPSRAM0_MODULE);
    SYS_ResetModule(SYS_LPPDMA0RST);

    /* Set multi-function pins for DMIC */
    SET_DMIC0_CLK_PB4();
    SET_DMIC0_DAT_PB5();
#endif
#else
    /* Enable Internal RC 12MHz clock */
    CLK_EnableXtalRC(CLK_SRCCTL_HIRCEN_Msk);

    /* Waiting for Internal RC clock ready */
    CLK_WaitClockReady(CLK_STATUS_HIRCSTB_Msk);

    /* Enable HXT clock */
    CLK_EnableXtalRC(CLK_SRCCTL_HXTEN_Msk);

    /* Waiting for HXT clock ready */
    CLK_WaitClockReady(CLK_STATUS_HXTSTB_Msk);

    /* Switch SCLK clock source to APLL0 and Enable APLL0 220MHz clock */
    CLK_SetBusClock(CLK_SCLKSEL_SCLKSEL_APLL0, CLK_APLLCTL_APLLSRC_HXT, FREQ_220MHZ);

    /* Update System Core Clock */
    /* User can use SystemCoreClockUpdate() to calculate SystemCoreClock. */
    SystemCoreClockUpdate();

    /* Enable GPIO module clock */
    CLK_EnableModuleClock(GPIOA_MODULE);
    CLK_EnableModuleClock(GPIOB_MODULE);
    CLK_EnableModuleClock(GPIOC_MODULE);
    CLK_EnableModuleClock(GPIOD_MODULE);
    CLK_EnableModuleClock(GPIOE_MODULE);
    CLK_EnableModuleClock(GPIOF_MODULE);
    CLK_EnableModuleClock(GPIOG_MODULE);
    CLK_EnableModuleClock(GPIOH_MODULE);
    CLK_EnableModuleClock(GPIOI_MODULE);
    CLK_EnableModuleClock(GPIOJ_MODULE);

    /* Enable FMC0 module clock to keep FMC clock when CPU idle but NPU running*/
    CLK_EnableModuleClock(FMC0_MODULE);

    /* Enable NPU module clock */
    CLK_EnableModuleClock(NPU0_MODULE);

    /* Select UART6 module clock source as HIRC and UART6 module clock divider as 1 */
    SetDebugUartCLK();

    // DMIC_APLL1_FREQ_196608KHZ for DMIC 8000/16000/48000 Hz sample-rate with 64/128/256 down-sample
    CLK_EnableAPLL(CLK_APLLCTL_APLLSRC_HIRC, DMIC_APLL1_FREQ_196608KHZ, CLK_APLL1_SELECT);
    // Select DMIC CLK source from APLL1_DIV2.
    CLK_SetModuleClock(DMIC0_MODULE, CLK_DMICSEL_DMIC0SEL_APLL1_DIV2, MODULE_NoMsk);
    // Enable DMIC clock.
    CLK_EnableModuleClock(DMIC0_MODULE);
    // DPWM IPReset.
    SYS_ResetModule(SYS_DMIC0RST);

    // LPPDMA Initial.
    CLK_EnableModuleClock(LPPDMA0_MODULE);
    CLK_EnableModuleClock(LPSRAM0_MODULE);
    SYS_ResetModule(SYS_LPPDMA0RST);

    /*---------------------------------------------------------------------------------------------------------*/
    /* Init I/O Multi-function                                                                                 */
    /*---------------------------------------------------------------------------------------------------------*/

    /* Set multi-function pins for UART RXD and TXD */
    SetDebugUartMFP();

    /* Set multi-function pins for DMIC */
    SET_DMIC0_CLK_PB4();
    SET_DMIC0_DAT_PB5();
#endif
}

/**
  * @brief Initiate the hardware resources of board
  * @return 0: Success, <0: Fail
  * @details Initiate clock, UART, NPU, hyperflash/hyperRAM
  * \hideinitializer
  */
int BoardInit(void)
{
    /* Unlock protected registers */
    SYS_UnlockReg();

    SYS_Init();

    /* On zephyr, go in zephyr way */
#if !defined(__ZEPHYR__)
    /* UART init - will enable valid use of printf (stdout
     * re-directed at this UART (UART6) */
    InitDebugUart();
#endif

    SYS_LockReg();                   /* Unlock register lock protect */

    info("%s: complete\n", __FUNCTION__);

#if defined(ARM_NPU)

    int state;

    /* If Arm Ethos-U NPU is to be used, we initialise it here */
    if (0 != (state = arm_ethosu_npu_init()))
    {
        return state;
    }

#endif /* ARM_NPU */

    /* Print target design info */
    info("Target system: %s\n", DESIGN_NAME);

    return 0;
}
```
